# STM32F413 register map
File version: 1.5
CPU: CM4 r0p1, little endian, MPU, FPU, 4 interrupt priority bits
Registers are 32-bit, read-write, reset 0x0 unless marked. A register's access mark holds for its fields unless they carry their own. Offsets are from the block's base; lines under a group give offsets from that group; [hi:lo] are bit positions; {n}, {i} and the like mark numbered series; 'fields as' and 'values as' point back to an identical list; <NAME> marks a mode.

## Memory map
0x40000000 TIM2 size 0x55 — General purpose timers
0x40000400 TIM3 size 0x51 — General purpose timers
0x40000800 TIM4 size 0x51
0x40000C00 TIM5 size 0x55 — General-purpose-timers
0x40001000 TIM6 size 0x51
0x40001400 TIM7 size 0x51 — Basic timers
0x40001800 TIM12 size 0x3D — General purpose timers
0x40001C00 TIM13 size 0x3D — General purpose timers
0x40002000 TIM14 size 0x3D
0x40002400 LPTIM size 0x21 — Low power timer
0x40002800 RTC size 0xA1 — Real-time clock
0x40002C00 WWDG size 0x11 — Window watchdog
0x40003000 IWDG size 0x11 — Independent watchdog
0x40003800 SPI2 size 0x400
0x40003C00 SPI3 size 0x400
0x40004400 USART2 size 0x1D
0x40004800 USART3 size 0x1D — Universal synchronous asynchronous receiver transmitter
0x40004C00 UART4 size 0x1D
0x40005000 UART5 size 0x1D
0x40005400 I2C1 size 0x29
0x40005800 I2C2 size 0x29 — Inter-integrated circuit
0x40005C00 I2C3 size 0x29
0x40006000 FMPI2C size 0x2D — fast-mode Inter-integrated circuit
0x40006400 CAN1 size 0x321 — Controller area network
0x40006800 CAN2 size 0x321
0x40006C00 CAN3 size 0x321
0x40007000 PWR size 0x9 — Power control
0x40007400 DAC size 0x39 — Digital-to-analog converter
0x40007800 UART7 size 0x1D
0x40007C00 UART8 size 0x1D
0x40010000 TIM1 size 0x51 — Advanced-timers
0x40010400 TIM8 size 0x51
0x40011000 USART1 size 0x1D
0x40011400 USART6 size 0x1D
0x40011800 UART9 size 0x1D
0x40011C00 UART10 size 0x1D
0x40012000 ADC1 size 0x51 — Analog-to-digital converter
0x40012300 ADC_Common size 0x9 — ADC common registers
0x40012C00 SDIO size 0x85 — Secure digital input/output interface
0x40013000 SPI1 size 0x400
0x40013400 SPI4 size 0x400
0x40013800 SYSCFG size 0x31 — System configuration controller
0x40013C00 EXTI size 0x19 — External interrupt/event controller
0x40014000 TIM9 size 0x3D — General purpose timers
0x40014400 TIM10 size 0x39 — General-purpose-timers
0x40014800 TIM11 size 0x400 — General-purpose-timers
0x40015000 SPI5 size 0x400 — Serial peripheral interface
0x40015400 SPI6 size 0x400
0x40015800 SAI size 0x400 — Serial audio interface
0x40016000 DFSDM1 size 0x400
0x40016400 DFSDM2 size 0x400 — Digital filter for sigma delta modulators
0x40020000 GPIOA size 0x29 — General-purpose I/Os
0x40020400 GPIOB size 0x29 — General-purpose I/Os
0x40020800 GPIOC size 0x29
0x40020C00 GPIOD size 0x29
0x40021000 GPIOE size 0x29
0x40021400 GPIOF size 0x29 — General-purpose I/Os
0x40021800 GPIOG size 0x29
0x40021C00 GPIOH size 0x29
0x40023000 CRC size 0xD — Cryptographic processor
0x40023800 RCC size 0x99 — Reset and clock control
0x40023C00 FLASH size 0x19
0x40026000 DMA1 size 0x400 — DMA controller
0x40026400 DMA2 size 0x400
0x50000000 OTG_FS_GLOBAL size 0x111 — USB on the go full speed
0x50000400 OTG_FS_HOST size 0x1F5 — USB on the go full speed
0x50000800 OTG_FS_DEVICE size 0x375 — USB on the go full speed
0x50000E00 OTG_FS_PWRCLK size 0x5 — USB on the go full speed
0x50060000 AES size 0x31 — Advanced encryption standard hardware accelerator
0x50060800 RNG size 0x11 — Random number generator
0x60000000 FSMC size 0x400 — Flexible static memory controller
0xA0001000 QUADSPI size 0x35 — QuadSPI interface
0xE000E008 SCB_ACTRL size 0x5 — System control block ACTLR
0xE000E010 STK size 0x11 — SysTick timer
0xE000E100 NVIC size 0x351 — Nested Vectored Interrupt Controller
0xE000ED00 SCB size 0x41 — System control block
0xE000ED88 FPU_CPACR size 0x5 — Floating point unit CPACR
0xE000ED90 MPU size 0x15 — Memory protection unit
0xE000EF00 NVIC_STIR size 0x5 — Nested vectored interrupt controller
0xE000EF34 FPU size 0xD — Floting point unit
0xE0042000 DBG size 0x11 — Debug support

## Interrupts
1 PVD (QUADSPI) — PVD through EXTI line detection interrupt
2 TAMP_STAMP (EXTI) — Tamper and TimeStamp interrupts through the EXTI line
3 RTC_WKUP (RCC) — RTC Wakeup interrupt through the EXTI line
4 FLASH — FLASH global interrupt
5 RCC (SDIO) — RCC global interrupt
6 EXTI0 (EXTI) — EXTI Line0 interrupt
7 EXTI1 (EXTI) — EXTI Line1 interrupt
8 EXTI2 (EXTI) — EXTI Line2 interrupt
9 EXTI3 (EXTI) — EXTI Line3 interrupt
10 EXTI4 (EXTI) — EXTI Line4 interrupt
11 DMA1_Stream0 (DMA1) — DMA1 Stream0 global interrupt
12 DMA1_Stream1 (DMA1) — DMA1 Stream1 global interrupt
13 DMA1_Stream2 (DMA1) — DMA1 Stream2 global interrupt
14 DMA1_Stream3 (DMA1) — DMA1 Stream3 global interrupt
15 DMA1_Stream4 (DMA1) — DMA1 Stream4 global interrupt
16 DMA1_Stream5 (DMA1) — DMA1 Stream5 global interrupt
17 DMA1_Stream6 (GPIOE) — DMA1 Stream6 global interrupt
18 ADC (ADC1) — ADC1 global interrupt
19 CAN1_TX (CAN1) — CAN1 TX interrupts
20 CAN1_RX0 (CAN1) — CAN1 RX0 interrupts
21 CAN1_RX1 (CAN1) — CAN1 RX1 interrupts
22 CAN1_SCE (CAN1) — CAN1 SCE interrupt
23 EXTI9_5 (EXTI) — EXTI Line[9:5] interrupts
24 TIM1_BRK_TIM9 (TIM3) — TIM1 Break interrupt and TIM9 global interrupt
25 TIM1_UP_TIM10 (TIM11) — TIM1 Update interrupt and TIM10 global interrupt
26 TIM1_TRG_COM_TIM11 (TIM5) — TIM1 Trigger and Commutation interrupts and TIM11 global interrupt
27 TIM1_CC (TIM1) — TIM1 Capture Compare interrupt
28 TIM2 (GPIOF) — TIM2 global interrupt
29 TIM3 (TIM4) — TIM3 global interrupt
30 TIM4 (TIM2) — TIM4 global interrupt
31 I2C1_EVT (I2C3) — I2C1 event interrupt
32 I2C1_ERR (I2C3) — I2C1 error interrupt
33 I2C2_EVT (I2C1) — I2C2 event interrupt
34 I2C2_ERR (I2C1) — I2C2 error interrupt
35 SPI1 (SPI3) — SPI1 global interrupt
36 SPI2 (SYSCFG) — SPI2 global interrupt
37 USART1 (OTG_FS_HOST) — USART1 global interrupt
38 USART2 (UART8) — USART2 global interrupt
39 USART3 (USART2) — USART3 global interrupt
40 EXTI15_10 (EXTI) — EXTI Line[15:10] interrupts
41 EXTI17_RTC_Alarm (RCC) — RTC Alarms (A and B) through EXTI line interrupt
43 TIM8_BRK_TIM12 (TIM13) — Timer 12 global interrupt
44 TIM8_UP_TIM13 (TIM14) — Timer 13 global interrupt
45 TIM8_TRG_COM_TIM14 (TIM9) — Timer 14 global interrupt
46 TIM8_CC (TIM8) — TIM8 Cap/Com interrupt
47 DMA1_Stream7 (DMA1) — DMA1 global interrupt Channel 7
48 FSMC (TIM12) — FSMC global interrupt
49 SDIO (SAI) — SDIO global interrupt
50 TIM5 (IWDG) — TIM5 global interrupt
51 SPI3 (UART4) — SPI3 global interrupt
52 USART4 (UART5) — UART 4 global interrupt
53 UART5 (UART10) — UART 5global interrupt
54 TIM6_GLB_IT_DAC1_DAC2 (TIM6) — TIM6 global and DAC12 underrun interrupts
55 TIM7 — TIM7 global interrupt
56 DMA2_Stream0 (DMA2) — DMA2 Stream0 global interrupt
57 DMA2_Stream1 (DMA2) — DMA2 Stream1 global interrupt
58 DMA2_Stream2 (DMA2) — DMA2 Stream2 global interrupt
59 DMA2_Stream3 (DMA2) — DMA2 Stream3 global interrupt
60 DMA2_Stream4 (DMA2) — DMA2 Stream4 global interrupt
61 DFSDM1_FLT0 (DFSDM1) — SD filter0 global interrupt
62 DFSDM1_FLT1 (DFSDM1) — SD filter1 global interrupt
63 CAN2_TX (CAN2) — CAN2 TX interrupt
64 CAN2_RX0 (CAN2) — BXCAN2 RX0 interrupt
65 CAN2_RX1 (CAN2) — BXCAN2 RX1 interrupt
66 CAN2_SCE (CAN2) — CAN2 SCE interrupt
68 DMA2_Stream5 (DMA2) — DMA2 Stream5 global interrupt
69 DMA2_Stream6 (DMA2) — DMA2 Stream6 global interrupt
70 DMA2_Stream7 (DMA2) — DMA2 Stream7 global interrupt
71 USART6 (UART7) — USART6 global interrupt
72 I2C3_EV (LPTIM) — I2C3 event interrupt
73 I2C3_ER (LPTIM) — I2C3 error interrupt
74 CAN3_TX (CAN3) — CAN 3 TX interrupt
75 CAN3_RX0 (CAN3) — BxCAN 3 RX0 interrupt
76 CAN3_RX1 (FMPI2C) — BxCAN 3 RX1 interrupt
77 CAN3_SCE (CAN3) — CAN 3 SCE interrupt
79 CRYPTO (AES) — AES global interrupt
80 RNG (CAN1) — Rng global interrupt
81 FPU (SDIO, ADC_Common, FPU) — FPU global interrupt
82 USART7 (USART1) — USART7 global interrupt
83 USART8 (UART9) — USART8 global interrupt
84 SPI4 (SPI1) — SPI4 global interrupt
85 SPI5 (SPI4) — SPI5 global interrupt
87 SAI1 (AES) — SAI1 global interrupt
88 UART9 (OTG_FS_PWRCLK) — UART9 global interrupt
89 UART10 (OTG_FS_DEVICE) — UART10 global interrupt
92 QuadSPI (NVIC) — Quad-SPI global interrupt
95 I2CFMP1event (TIM12) — I2CFMP1 event interrupt
96 I2CFMP1error (TIM12) — I2CFMP1 error interrupt
97 lptim1_OR_it_eit_23 (EXTI) — LP Timer global interrupt or EXT1 interrupt line 23
98 DFSDM2_FILTER1 (TIM6) — DFSDM2 SD filter 1 global interrupt
99 DFSDM2_FILTER2 (DFSDM2) — DFSDM2 SD filter 2 global interrupt
100 DFSDM2_FILTER3 (TIM6) — DFSDM2 SD filter 3 global interrupt
101 DFSDM2_FILTER4 (DFSDM2) — DFSDM2 SD filter 4 global interrupt
